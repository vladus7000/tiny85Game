#define F_CPU 10000000
#include <avr/io.h>
#include <avr/delay.h>
#include "Lcd.h"
#include "TinyWireM.h"

const unsigned char StartScreen [] = { // 21 x 8(1 p)
0xFE, 0x92, 0x92, 0x92, 0x82, 0x00, 0x04, 0x88, 0x78, 0x10, 0x78, 0x84, 0x00, 0x00, 0xFD, 0x00,
0x00, 0x84, 0xFF, 0x84, 0x84,
};
/*
const unsigned char arrow [] = { // 48 x 16(2 pages)
	0xC0, 0xE0, 0xE0, 0xE0, 0xE0, 0xE0, 0xE0, 0xE0, 0xE0, 0xE0, 0xE0, 0xE0, 0xE0, 0xE0, 0xE0, 0xE0,
	0xE0, 0xE0, 0xE0, 0xE0, 0xE0, 0xFF, 0xFF, 0xFF, 0xFF, 0xFF, 0xFF, 0xFE, 0xFE, 0xFE, 0xFC, 0xFC,
	0xF8, 0xF8, 0xF8, 0xF8, 0xF0, 0xF0, 0xF0, 0xE0, 0xE0, 0xC0, 0xC0, 0xC0, 0x80, 0x80, 0x00, 0x00,
	0x1F, 0x3F, 0x3F, 0x3F, 0x3F, 0x3F, 0x3F, 0x3F, 0x3F, 0x3F, 0x3F, 0x3F, 0x3F, 0x3F, 0x3F, 0x3F,
	0x3F, 0x3F, 0x3F, 0x3F, 0x3F, 0x7F, 0xFF, 0xFF, 0xFF, 0xFF, 0xFF, 0x7F, 0x7F, 0x7F, 0x7F, 0x7F,
	0x3F, 0x3F, 0x3F, 0x3F, 0x3F, 0x1F, 0x1F, 0x1F, 0x1F, 0x1F, 0x0F, 0x0F, 0x0F, 0x0F, 0x07, 0x00
};*/

const unsigned char shelf [] = { //12x1(3p)
0xFF,0xFF,0xFF,0xFF,0xFF,0xFF,0xFF,0xFF,0xFF,0xFF,0xFF,0xFF,
};

const unsigned char basket_left [] = { //24x24(3p)
	0x00, 0x00, 0x00, 0xF8, 0xFE, 0xFF, 0x0F, 0x0F, 0x0F, 0x0E, 0x0C, 0x1C, 0xFC, 0xF8, 0xF8, 0xF0,
	0xC0, 0x00, 0x00, 0x00, 0x00, 0x00, 0x00, 0x00, 0xC0, 0xE0, 0xF0, 0xFB, 0xFF, 0xFF, 0xFC, 0xFC,
	0xFC, 0xFC, 0xFC, 0xFC, 0xFF, 0xFF, 0xFF, 0xFF, 0xFF, 0xFC, 0xE0, 0xE0, 0x00, 0x00, 0x00, 0x00,
	0x01, 0x07, 0x0F, 0x1F, 0x1F, 0x3F, 0x3F, 0x3F, 0x36, 0x31, 0x31, 0x30, 0x30, 0x33, 0x3F, 0x7F,
	0x7D, 0x7F, 0xFB, 0xF0, 0xF0, 0xF0, 0xE0, 0xC0,
};

const unsigned char basket_right [] = { //24x24(3p)
	0x00, 0x00, 0x00, 0x00, 0x00, 0x00, 0x00, 0xC0, 0xF0, 0xF8, 0x38, 0x1C, 0x1C, 0x1C, 0x1E, 0x0F,
	0x07, 0x07, 0xC7, 0xFE, 0xF8, 0x00, 0x00, 0x00, 0x00, 0x00, 0x00, 0x00, 0xE0, 0xE0, 0xFC, 0xFF,
	0xFF, 0xFF, 0xFC, 0xFC, 0xFC, 0xFC, 0xFC, 0xFC, 0xFC, 0xFC, 0xFF, 0xFF, 0xFB, 0xF0, 0xE0, 0xC0,
	0xC0, 0xE0, 0xF0, 0xF0, 0xF0, 0xFB, 0x7F, 0x7D, 0x7F, 0x3F, 0x33, 0x30, 0x30, 0x31, 0x31, 0x36,
	0x3F, 0x3F, 0x3F, 0x1F, 0x1F, 0x0F, 0x07, 0x01
};

const unsigned char egg [] = { // 12x8(3p)
	0x1C, 0x7E, 0x7F, 0xE7, 0xE3, 0xC3, 0xC3, 0xC3, 0xC7, 0xEF, 0xFE, 0x7C
};

const unsigned char wolf [] = { // 28x48(6p)
0x00, 0x00, 0x00, 0x00, 0x00, 0x80, 0x00, 0x18, 0xDC, 0xFE, 0xFF, 0xFE, 0xFF, 0xFF, 0xFF, 0xFF,
0xFE, 0xFF, 0xFF, 0xFF, 0xFE, 0xFF, 0xFF, 0xFE, 0x00, 0x00, 0x00, 0x00, 0x00, 0x00, 0x00, 0x00,
0xFF, 0xFF, 0xFF, 0xFF, 0xDE, 0xFE, 0xFF, 0xFF, 0xFF, 0xFF, 0xFF, 0x3F, 0x3F, 0xFF, 0xFF, 0xFF,
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0xFF, 0xFF, 0xFF, 0xFD, 0xFC, 0x7C, 0x3E, 0x1C,
};

void drawEgg(uint8_t page, uint8_t seg)
{
	drawImage(page, seg, 12, 8, egg);
}

void clearEgg(uint8_t page, uint8_t seg)
{
	clearRegion(page, seg, page+1, seg+11);
}

struct Button
{
	enum State
	{
		Up,
		FirstPressed,
		Hold,
		FirstUp,
	};

	Button()
	{}

	Button(uint8_t i, uint8_t j)
	: pinNumber(i)
	{
		DDRB &= ~(1 << j);
	}

	void update()
	{
		bool pressed = PINB & (1 << pinNumber);

		switch (state)
		{
			case Up:
				if (pressed) state = FirstPressed;
			break;
			case FirstPressed:
				if (pressed) state = Hold; else state = FirstUp;
			break;
			case Hold:
				if (pressed) state = Hold; else state = FirstUp;
			break;
			case FirstUp:
				if (pressed) state = FirstPressed; else state = Up;
			break;
			default:
			break;
		}
	}

	State state = Up;
	uint8_t pinNumber;
};

struct ButtonState
{
	void update()
	{
		yellowButton.update();
		redButton.update();
		whiteButton.update();
	}

	Button yellowButton;
	Button redButton;
	Button whiteButton;
};

class State
{
public:
	~State() {};

	virtual void update(const ButtonState& state) {};
	virtual void transition(State* parent) {}
};

State *g_main, *g_game, *g_current;
void ChangeStateTo(State* to, State* from)
{
	to->transition(from);
	g_current = to;
}

class MainScreen : public State
{
public:
	MainScreen()
	{
		g_main = this;
	}

	virtual void update(const ButtonState& state) override
	{
		if (state.yellowButton.state == Button::FirstPressed || state.whiteButton.state == Button::FirstPressed)
		{
			clearEgg(arrowPageStart[arrowIndex&1], 20);
			arrowIndex++;
		}
		
		if (state.redButton.state == Button::FirstPressed && (arrowIndex&1) == 0)
		{
			ChangeStateTo(g_game, g_main);
			return;	
		}

		drawEgg(arrowPageStart[arrowIndex&1], 20);
		drawImage(1, 52, 24, 24, basket_left);
		drawImage(5, 50, 21, 8, StartScreen);
	}

	virtual void transition(State* parent) override
	{
		clearScreen();
	}
private:
	unsigned char arrowIndex = 0;
	const uint8_t arrowPageStart[2] = {2, 5};
};

class Game : public State
{
public:
	Game()
	{
		g_game = this;
	}

	virtual void update(const ButtonState& state) override
	{
		if (state.yellowButton.state == Button::FirstPressed)
		{
			drawImage(3, 26, 24, 24, basket_left);
			clearRegion(3, 78, 5, 78+23);
			m_isBasketLeft = true;
		}
		if (state.whiteButton.state == Button::FirstPressed)
		{
			drawImage(3, 78, 24, 24, basket_right);
			clearRegion(3, 26, 5, 49);
			m_isBasketLeft = false;
		}

		if (m_leftEggStage == 2 && m_isBasketLeft && m_leftTimer < 15)
		{
			m_leftEggStage = 0;
			m_leftTimer = 0;
			clearRegion(1, 12, 1, 12+11);
		}

		if (m_rightEggStage == 2 && !m_isBasketLeft && m_rightTimer < 17)
		{
			m_rightEggStage = 0;
			m_rightTimer = 0;
			clearRegion(0, 116, 0, 116+11);
		}

		if (m_leftTimer++ > 15)
		{
			m_leftTimer = 0;
			switch(m_leftEggStage)
			{
				case 0:
				m_leftEggStage = 1;
				clearRegion(7, 24, 7, 24+11);
				break;
				case 1:
					drawEgg(0, 0);
					m_leftEggStage = 2;
				break;
				case 2:
					drawEgg(1, 12);
					clearRegion(0, 0, 0, 11);
					m_leftEggStage = 3;
				break;
				case 3:
					drawEgg(7, 24);
					clearRegion(1, 12, 1, 12+11);
					m_leftEggStage = 0;
					m_health--;
				break;
				}
		}

		if (m_rightTimer++ > 17)
		{
			m_rightTimer = 0;
			switch(m_rightEggStage)
			{
				case 0:
					m_rightEggStage = 1;
					clearRegion(7, 92, 7, 92+11);
					break;
				case 1:
					m_rightEggStage = 2;
					drawEgg(0, 116);
				break;
				case 2:
					m_rightEggStage = 3;
					drawEgg(1, 104);
					clearRegion(0, 116, 0, 116+11);
				break;
				case 3:
					drawEgg(7, 92);
					clearRegion(1, 104, 1, 104+11);
					m_rightEggStage = 0;
					m_health--;
				break;
				}
		}
		
		// Map
		drawImage(1, 0, 12, 8, shelf); 
		drawImage(2, 0, 12, 8, shelf); 
		drawImage(2, 12, 12, 8, shelf); 
		
		drawImage(1, 116, 12, 8, shelf);
		drawImage(2, 116, 12, 8, shelf);
		drawImage(2, 104, 12, 8, shelf);

		drawImage(2, 50, 28, 48, wolf);
		//End map

		//health
		for (uint8_t i = 0; i < 3; i++)
		{
			clearRegion(0, 44 + 12 * i + i*2, 0, 44 + 12 * i + i*2+11);
		}
		for (uint8_t i = 0; i < m_health; i++)
		{
			drawEgg(0, 44 + 12 * i + i*2);
		}


		if (m_health == 0)
		{
			_delay_ms(200);
			ChangeStateTo(g_main, g_main);
		}
	}

	virtual void transition(State* parent) override
	{
		m_health = 3;
		m_leftEggStage = 0;
		m_rightEggStage = 0;
		m_leftTimer = 5;
		m_rightTimer = 0;
		m_isBasketLeft = true;
		m_from = parent;
		clearScreen();
		drawImage(3, 26, 24, 24, basket_left);
	}
private:
	uint8_t m_leftEggStage;
	uint8_t m_rightEggStage;
	uint8_t m_leftTimer;
	uint8_t m_rightTimer;
	State* m_from;
	uint8_t m_health;
	uint8_t m_isBasketLeft;
};

static MainScreen ms;
static Game game;

int main(void)
{
	TinyWireM.begin();
	lcdInit();

	ButtonState buttonState;
	buttonState.yellowButton = Button(PINB4, DDB4);
	buttonState.redButton = Button(PINB1, DDB1);
	buttonState.whiteButton = Button(PINB3, DDB3);

	ChangeStateTo(g_main, 0);

    while (1) 
    {
		buttonState.update();
		g_current->update(buttonState);

    }
}

